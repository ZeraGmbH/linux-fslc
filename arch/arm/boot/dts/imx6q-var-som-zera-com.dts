/dts-v1/;

#include "imx6q-var-som-zera.dtsi"

&ldb {
	ext_ref = <1>;
	status = "okay";

	lvds-channel@0 {
		fsl,data-mapping = "spwg";
		fsl,data-width = <24>;
		status = "okay";
		primary;

		display-timings {
			native-mode = <&timing0>;
			timing0: hsd100pxn1 {
				clock-frequency = <50400000>;
				hactive = <1024>;
				vactive = <600>;
				hback-porch = <220>;
				hfront-porch = <40>;
				hsync-len = <60>;
				vback-porch = <5>;
				vfront-porch = <10>;
				vsync-len = <10>;
			};
		};
	};
};
