/dts-v1/;

#include "imx6q-var-som-zera.dtsi"

&ldb {
	ext_ref = <1>;
	status = "okay";

	lvds-channel@0 {
		fsl,data-mapping = "spwg";
		fsl,data-width = <24>;
		status = "okay";
		primary;

		display-timings {
			native-mode = <&timing0>;
			timing0: hsd100pxn1 {
				clock-frequency = <72403200>;
				hactive = <1280>;
				vactive = <800>;
				hback-porch = <20>;
				hfront-porch = <140>;
				hsync-len = <2>;
				vback-porch = <8>;
				vfront-porch = <30>;
				vsync-len = <1>;
			};
		};
	};
};
